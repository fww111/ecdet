# SPC3000 register map
航天姿轨控计算机 SoC（样例用寄存器模型）
Registers are 32-bit, read-only, no defined reset value unless marked. A register's access mark holds for its fields unless they carry their own. Offsets are from the block's base; lines under a group give offsets from that group; [hi:lo] are bit positions; {n}, {i} and the like mark numbered series; 'fields as' and 'values as' point back to an identical list; <NAME> marks a mode.

## Memory map
0x40020000 GPIOA
0x40022000 ADC
0x40023000 SPI1
0x40024000 USART1
0x40025000 TIM2
0x40026000 IWDG
0x40027000 RTC
0x40028000 CAN1
0x4002A000 TRX

## GPIOA
Base 0x40020000
0x10 IDR
0x14 ODR rw
0x18 BSRR wo

## ADC
Base 0x40022000
0x00 SR
0x04 CR rw
0x08 DR

## SPI1
Base 0x40023000
0x00 CR1 rw
0x08 SR
0x0C DR rw

## USART1
Base 0x40024000
0x00 SR
0x04 DR rw
0x08 CR1 rw

## TIM2
Base 0x40025000
0x00 CR1 rw
0x10 SR
0x24 CNT
0x2C ARR rw

## IWDG
Base 0x40026000
0x00 KR wo
0x04 PR rw
0x08 SR

## RTC
Base 0x40027000
0x00 TR
0x04 DR
0x08 CR rw

## CAN1
Base 0x40028000
0x00 MCR rw
0x04 MSR
0x08 TSR
0x0C RFR

## TRX
Base 0x4002A000
0x00 CTRL rw
0x04 STATUS
0x08 FIFO rw
0x0C AGC
0x10 RANGE rw
